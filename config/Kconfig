## config/drivers/behaviors/Kconfig
```kconfig
config ZMK_BEHAVIOR_TP_TUNE
	bool "tp_tune behavior for runtime trackpoint tuning"
	default y
	depends on DT_HAS_ZMK_BEHAVIOR_TP_TUNE_ENABLED
	depends on INPUT_HANC_TRACKPOINT_I2C
	help
	  Enable the &tp_tune ZMK behavior that adjusts sensitivity, inversion
	  and axis swap of a hanc,trackpoint-i2c device at runtime from the
	  keymap.
```

## config/drivers/input/Kconfig
```kconfig
menuconfig INPUT_TRACKPOINT
    bool "ATTiny I2C TrackPoint input driver"
    default y
    depends on DT_HAS_ZMK_INPUT_TRACKPOINT_ENABLED
    select I2C
    select INPUT
    help
      Enable the out-of-tree ATTiny-over-I2C TrackPoint driver that emits
      INPUT_REL_X / INPUT_REL_Y events suitable for ZMK's pointing subsystem.

if INPUT_TRACKPOINT

config INPUT_TRACKPOINT_INVERT_X
    bool "Invert X axis"
    default n
    help
      Negate the reported dx value before emitting the input event.

config INPUT_TRACKPOINT_INVERT_Y
    bool "Invert Y axis"
    default y
    help
      Negate the reported dy value before emitting the input event.
      Enabled by default because the sensor's native Y direction is
      opposite to the HID mouse convention on this hardware.

config INPUT_TRACKPOINT_SWAP_XY
    bool "Swap X and Y axes"
    default n
    help
      Swap dx and dy before applying the invert flags. Useful if the
      sensor is mounted rotated 90 degrees relative to the keyboard.

config INPUT_TRACKPOINT_LOG_LEVEL
    int "Log level"
    default 2
    range 0 4
    help
      0=off, 1=err, 2=wrn, 3=inf, 4=dbg

endif # INPUT_TRACKPOINT
```

## config/dts/bindings/behaviors/zmk,behavior-tp-tune.yaml
```yaml
description: |
  Keymap-bindable behavior that tunes a hanc,trackpoint-i2c device at runtime.

  Binding params:
    param1: action code (see include/dt-bindings/zmk/tp_tune.h)
    param2: optional value (e.g. percent for TP_SENS_SET)

compatible: "zmk,behavior-tp-tune"

properties:
  label:
    type: string
  "#binding-cells":
    type: int
    required: true
    const: 2
  device:
    type: phandle
    required: true
    description: Phandle to the hanc,trackpoint-i2c device to tune.
```

## config/dts/bindings/input/hanc,trackpoint-i2c.yaml
```yaml
description: |
  hanc ATTiny-based I2C TrackPoint module.

  Reports a 10-byte frame: [seq, dx_lo, dx_hi, dy_lo, dy_hi,
                            x_lo, x_hi, y_lo, y_hi, buttons].

  Dynamic polling: idle -> low-poll-ms, on motion -> high-poll-ms,
  revert after idle-timeout-ms of no motion.

compatible: "hanc,trackpoint-i2c"

include: i2c-device.yaml

properties:
  low-poll-ms:
    type: int
    default: 125
    description: Idle-state poll interval in milliseconds.

  high-poll-ms:
    type: int
    default: 5
    description: Active-state poll interval in milliseconds.

  idle-timeout-ms:
    type: int
    default: 1500
    description: Time of no motion before reverting to idle polling.

  dead-zone:
    type: int
    default: 20
    description: Absolute value below which dx/dy are treated as zero.

  offset-filter-shift:
    type: int
    default: 4
    description: |
      Right-shift amount used by the Q8 baseline drift filter in idle mode.
      Higher = slower baseline tracking. 4 means 1/16 update per sample.

  invert-x:
    type: boolean
    description: Invert the reported X axis.

  invert-y:
    type: boolean
    description: Invert the reported Y axis.

  swap-xy:
    type: boolean
    description: Swap X and Y axes (applied before invert).

  sensitivity-percent:
    type: int
    default: 100
    description: Pointer sensitivity as a percentage (100 = 1.0x).

  sensitivity-step-percent:
    type: int
    default: 25
    description: Step used by &tp_tune TP_SENS_UP / TP_SENS_DN.

  sensitivity-min-percent:
    type: int
    default: 25
    description: Minimum sensitivity (clamp bound for runtime adjust).

  sensitivity-max-percent:
    type: int
    default: 400
    description: Maximum sensitivity (clamp bound for runtime adjust).
```

## config/dts/bindings/input/zmk,input-trackpoint.yaml
```yaml
description: ATTiny I2C TrackPoint pointer

compatible: "zmk,input-trackpoint"

include: i2c-device.yaml

properties:
  poll-period-ms:
    type: int
    default: 8
    description: Poll period (ms) while the trackpoint is actively moving.

  idle-poll-period-ms:
    type: int
    default: 125
    description: Poll period (ms) when the trackpoint is idle.

  idle-timeout-ms:
    type: int
    default: 1500
    description: After this many ms without motion, revert from active to idle poll rate.

  dead-zone:
    type: int
    default: 30
    description: |
      Raw dx/dy samples within +/- this range are treated as no-motion and
      also used to adaptively learn the zero-motion baseline.

  sensitivity-shift:
    type: int
    default: 3
    description: |
      Right-shift applied to the compensated dx/dy before reporting.
      0 = raw (very fast), 1 = /2, 2 = /4, 3 = /8, ... Larger values
      produce slower, finer cursor motion. Fractional remainders are
      carried across polls so slow drags still move pixel-by-pixel.
```

## config/west.yml
```yaml
manifest:
  remotes:
    - name: zmkfirmware
      url-base: https://github.com/zmkfirmware
  projects:
    - name: zmk
      remote: zmkfirmware
      revision: v0.3.0
      import: app/west.yml
    - name: zmk-attiny-tp
      path: zmk-attiny-tp
  self:
    path: config
```

## drivers/input/Kconfig
```kconfig
config INPUT_HANC_TRACKPOINT_I2C
    bool "hanc ATTiny-based I2C trackpoint"
    default y
    depends on DT_HAS_HANC_TRACKPOINT_I2C_ENABLED
    depends on INPUT
    select I2C
    help
      Enable the custom I2C trackpoint driver that polls an ATTiny
      co-processor at address 0x20 for dx/dy/button reports and emits
      Zephyr input events.

if INPUT_HANC_TRACKPOINT_I2C

config INPUT_HANC_TRACKPOINT_I2C_THREAD_STACK_SIZE
    int "Stack size for the trackpoint poll work queue"
    default 1024

config INPUT_HANC_TRACKPOINT_I2C_LOG_LEVEL
    int "Log level for hanc_trackpoint_i2c (0=off 1=ERR 2=WRN 3=INF 4=DBG)"
    range 0 4
    default 2

endif # INPUT_HANC_TRACKPOINT_I2C
```

## dts/bindings/input/hanc,trackpoint-i2c.yaml
```yaml
description: ATTiny-based I2C trackpoint (10-byte seq/dx/dy/x/y/buttons packet)

compatible: "hanc,trackpoint-i2c"

include: i2c-device.yaml

properties:
  low-poll-ms:
    type: int
    default: 125
    description: Poll interval while idle (ms).

  high-poll-ms:
    type: int
    default: 5
    description: Poll interval while moving (ms).

  idle-timeout-ms:
    type: int
    default: 1500
    description: Return to idle polling after this many ms without motion.

  dead-zone:
    type: int
    default: 20
    description: Magnitude below which dx/dy are clamped to zero.

  offset-filter-shift:
    type: int
    default: 4
    description: |
      Q8 baseline-drift filter shift (alpha = 1/2^shift). Larger values
      learn the zero point more slowly.

  scale-shift:
    type: int
    default: 0
    description: |
      Right-shift applied to dx/dy before reporting (divide by 2^shift).
      The ATTiny emits raw force readings that are too large for a mouse
      HID report; a shift of 2-4 (divide by 4-16) usually feels right.

  max-delta:
    type: int
    default: 127
    description: |
      Per-report clamp for |dx| and |dy|. Prevents one stale/accumulated
      sample from teleporting the cursor.

  invert-x:
    type: boolean
    description: Negate dx before reporting.

  invert-y:
    type: boolean
    description: Negate dy before reporting.
```

## zmk-attiny-tp/drivers/input/Kconfig
```kconfig
config ATTINY_I2C_TP
    bool "ATTiny I2C Trackpoint input driver"
    default n
    depends on I2C && INPUT
    help
      Driver for trackpoint modules connected via I2C to an ATTiny
      co-processor. Reports relative X/Y movement and button events
      through Zephyr's input subsystem.
```

## zmk-attiny-tp/dts/bindings/input/attiny-i2c-tp.yaml
```yaml
description: ATTiny I2C Trackpoint

compatible: "attiny-i2c-tp"

include: i2c-device.yaml
```
